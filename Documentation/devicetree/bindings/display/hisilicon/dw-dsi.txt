## Documentation/devicetree/bindings/display/hisilicon/dw-dsi.txt
```
Device-Tree bindings for DesignWare DSI Host Controller v1.20a driver

A DSI Host Controller resides in the middle of display controller and external
HDMI converter.

Required properties:
- compatible: value should be "hisilicon,hi6220-dsi".
- reg: physical base address and length of the controller's registers.
- clocks: the clocks needed.
- clock-names: the name of the clocks.
- ports: contains DSI controller input and output sub port. The input port
  connects to ADE output port, and output port connected to external HDMI
  endpoint. See Documentation/devicetree/bindings/graph.txt for more device
  graph info.

A example of HiKey board hi6220 SoC and board specific DT entry:
Example:

SoC specific:
	dsi: dsi@0xf4107800 {
		compatible = "hisilicon,hi6220-dsi";
		reg = <0x0 0xf4107800 0x0 0x100>;
		clocks = <&media_ctrl  HI6220_DSI_PCLK>;
		clock-names = "pclk_dsi";

		ports {
			#address-cells = <1>;
			#size-cells = <0>;

			port@0 {
				reg = <0>;
				dsi_in: endpoint {
						remote-endpoint = <&ade_out>;
				};
			};

			port@1 {
				reg = <1>; /* 1 for output port */
				dsi_out: endpoint {
						 remote-endpoint = <&adv7533_in>;
				};
			};
		};
	};

Board specific:
	i2c2: i2c@f7102000 {
		...

		adv7533: adv7533@39 {
			...

			port {
				adv7533_in: endpoint {
					remote-endpoint = <&dsi_out>;
				};
			};
		};
	};
```

## Documentation/devicetree/bindings/display/hisilicon/hisi-ade.txt
```
Device-Tree bindings for hisilicon ADE display controller driver

ADE (Advanced Display Engine) is the display controller which grab image
data from memory, do composition, do post image processing, generate RGB
timing stream and transfer to DSI.

Required properties:
- compatible: value should be "hisilicon,hi6220-ade".
- reg: physical base address and length of the controller's registers.
- reg-names: name of physical base.
- interrupt: the interrupt number.
- clocks: the clocks needed.
- clock-names: the name of the clocks.
- assigned-clocks: clocks to be assigned rate.
- assigned-clock-rates: clock rates which are assigned to assigned-clocks.
- port: the output port. This contains one endpoint subnode, with its
  remote-endpoint set to the phandle of the connected DSI endpoint.
  See Documentation/devicetree/bindings/graph.txt for more device graph info.

Optional properties:
- dma-coherent: Present if dma operations are coherent.


A example of HiKey board hi6220 SoC specific DT entry:
Example:

	ade: ade@f4100000 {
		compatible = "hisilicon,hi6220-ade";
		reg = <0x0 0xf4100000 0x0 0x7800>,
		      <0x0 0xf4410000 0x0 0x1000>,
		      <0x0 0xf4520000 0x0 0x1000>;
		reg-names = "ade_base",
			    "media_base",
			    "media_noc_base";

		interrupts = <0 115 4>; /* ldi interrupt */

		clocks = <&media_ctrl HI6220_ADE_CORE>,
			 <&media_ctrl HI6220_CODEC_JPEG>,
			 <&media_ctrl HI6220_ADE_PIX_SRC>;
		/*clock name*/
		clock-names  = "clk_ade_core",
			       "clk_codec_jpeg",
			       "clk_ade_pix";

		assigned-clocks = <&media_ctrl HI6220_ADE_CORE>,
			<&media_ctrl HI6220_CODEC_JPEG>;
		assigned-clock-rates = <360000000>, <288000000>;
		dma-coherent;

		port {
			ade_out: endpoint {
				remote-endpoint = <&dsi_in>;
			};
		};
	};
```

## Documentation/devicetree/bindings/regulator/hisilicon,hi655x-regulator.txt
```
Hisilicon Hi655x Voltage regulators

Note:
The hi655x regulator control is managed by hi655x Power IC.
So the node of this regulator must be child node of hi655x
pmic node.

The driver uses the regulator core framework, so please also
take the bindings of regulator.txt for reference.

The valid names for regulators are:

ldo2 ldo7 ldo10 ldo13 ldo14 ldo15 ldo17 ldo19 ldo21 ldo22

Example:
        pmic: pmic@f8000000 {
                compatible = "hisilicon,hi655x-pmic";
		...
		regulators {
			ldo2: ldo2@a21 {
				regulator-compatible = "LDO2";
				regulator-min-microvolt = <2500000>;
				regulator-max-microvolt = <3200000>;
				regulator-enable-ramp-delay = <120>;
			};
			...
		}
	}
```
